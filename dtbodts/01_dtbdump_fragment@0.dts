/dts-v1/;

/ {

	__fixups__ {
		accdet = "/fragment@11:target:0";
		auxadc = "/fragment@25:target:0", "/fragment@26/__overlay__:io-channels:0";
		camera_af_hw_node = "/fragment@60:target:0";
		chosen = "/fragment@1:target:0";
		consys = "/fragment@15:target:0";
		dsi_te = "/fragment@44:target:0";
		fpc = "/fragment@4:target:0";
		gpio = "/fragment@38:target:0";
		gpio_usage_mapping = "/fragment@37:target:0";
		i2c0 = "/fragment@20:target:0", "/fragment@24:target:0", "/fragment@28:target:0", "/fragment@61:target:0";
		i2c1 = "/fragment@29:target:0";
		i2c2 = "/fragment@8:target:0", "/fragment@30:target:0";
		i2c3 = "/fragment@10:target:0", "/fragment@31:target:0";
		i2c4 = "/fragment@32:target:0";
		i2c5 = "/fragment@33:target:0";
		i2c6 = "/fragment@34:target:0";
		i2c7 = "/fragment@2:target:0", "/fragment@35:target:0";
		i2c8 = "/fragment@36:target:0";
		i2c_lcd_bias_mtk = "/fragment@19:target:0";
		irtx_pwm = "/fragment@16:target:0";
		kd_camera_hw1 = "/fragment@55:target:0", "/fragment@59:target:0";
		keypad = "/fragment@12:target:0", "/fragment@57:target:0";
		lcm_power_gpio = "/fragment@7:target:0";
		main_pmic = "/fragment@45:target:0";
		md1_sim1_hot_plug_eint = "/fragment@46:target:0";
		md1_sim2_hot_plug_eint = "/fragment@47:target:0";
		md_auxadc = "/fragment@26:target:0";
		mt_pmic_vcama1_ldo_reg = "/fragment@48:target:0", "/fragment@55/__overlay__:vcama-supply:0", "/fragment@59/__overlay__:cam2_vcama-supply:0";
		mt_pmic_vcama2_ldo_reg = "/fragment@49:target:0", "/fragment@55/__overlay__:vcama_sub-supply:0", "/fragment@59/__overlay__:cam1_vcama-supply:0";
		mt_pmic_vcamd_ldo_reg = "/fragment@52:target:0", "/fragment@55/__overlay__:vcamd_main2-supply:0", "/fragment@59/__overlay__:cam2_vcamd-supply:0";
		mt_pmic_vcamio_ldo_reg = "/fragment@53:target:0", "/fragment@55/__overlay__:vcamio-supply:0", "/fragment@55/__overlay__:vcamio_sub-supply:0", "/fragment@55/__overlay__:vcamio_main2-supply:0", "/fragment@59/__overlay__:cam0_vcamio-supply:0", "/fragment@59/__overlay__:cam1_vcamio-supply:0", "/fragment@59/__overlay__:cam2_vcamio-supply:0";
		mt_pmic_vldo28_ldo_reg = "/fragment@54:target:0", "/fragment@55/__overlay__:vcamaf-supply:0", "/fragment@55/__overlay__:vcamaf_sub-supply:0", "/fragment@55/__overlay__:vcamaf_main2-supply:0", "/fragment@56/__overlay__:vtouch-supply:0", "/fragment@59/__overlay__:cam0_vcamaf-supply:0", "/fragment@60/__overlay__:camaf_m1_pmic-supply:0", "/fragment@60/__overlay__:camaf_m2_pmic-supply:0", "/fragment@60/__overlay__:camaf_m3_pmic-supply:0", "/fragment@62/__overlay__:vtouch-supply:0";
		mt_pmic_vsim1_ldo_reg = "/fragment@50:target:0";
		mt_pmic_vsim2_ldo_reg = "/fragment@51:target:0";
		mtkfb = "/fragment@22:target:0";
		odm = "/fragment@6:target:0", "/fragment@9:target:0";
		pio = "/fragment@2/__overlay__/aw881xx_smartpa@34:reset-gpio:0", "/fragment@2/__overlay__/aw881xx_smartpa@34:irq-gpio:0", "/fragment@4/__overlay__:interrupt-parent:0", "/fragment@5:target:0", "/fragment@7/__overlay__:gpio_lcd_ldo18_gpio:0", "/fragment@7/__overlay__:gpio_lcd_bias_enp_gpio:0", "/fragment@7/__overlay__:gpio_lcd_bias_enn_gpio:0", "/fragment@9/__overlay__/nfc:gpio-rst-std:0", "/fragment@9/__overlay__/nfc:gpio-irq-std:0", "/fragment@9/__overlay__/irq_nfc:interrupt-parent:0", "/fragment@13:target:0", "/fragment@14:target:0", "/fragment@17:target:0", "/fragment@18:target:0", "/fragment@21:target:0", "/fragment@23:target:0", "/fragment@37/__overlay__:GPIO_SIM2_HOT_PLUG:0", "/fragment@37/__overlay__:GPIO_SIM1_HOT_PLUG:0", "/fragment@37/__overlay__:GPIO_SIM2_SIO:0", "/fragment@37/__overlay__:GPIO_SIM2_SRST:0", "/fragment@37/__overlay__:GPIO_SIM2_SCLK:0", "/fragment@37/__overlay__:GPIO_SIM1_SCLK:0", "/fragment@37/__overlay__:GPIO_SIM1_SRST:0", "/fragment@37/__overlay__:GPIO_SIM1_SIO:0", "/fragment@39/__overlay__:interrupt-parent:0", "/fragment@40/__overlay__:interrupt-parent:0", "/fragment@41/__overlay__:interrupt-parent:0", "/fragment@42/__overlay__:interrupt-parent:0", "/fragment@43/__overlay__:interrupt-parent:0", "/fragment@44/__overlay__:interrupt-parent:0", "/fragment@45/__overlay__:interrupt-parent:0", "/fragment@58:target:0", "/fragment@61/__overlay__/focaltech@48:interrupt-parent:0", "/fragment@61/__overlay__/tcm_touch@2c:interrupt-parent:0", "/fragment@61/__overlay__/tcm_touch@2c:omnivision,irq-gpio:0", "/fragment@61/__overlay__/tcm_touch@2c:omnivision,reset-gpio:0", "/fragment@62/__overlay__:interrupt-parent:0", "/fragment@62/__overlay__:goodix,eint-gpio:0", "/fragment@62/__overlay__:goodix,reset-gpio:0", "/fragment@62/__overlay__:gpio_tp_int:0", "/fragment@62/__overlay__:gpio_tp_rst:0", "/fragment@63:target:0";
		pmic_clock_buffer_ctrl = "/fragment@27:target:0";
		reserved_memory = "/fragment@0:target:0";
		rt9465_slave_chr = "/fragment@43:target:0";
		smart_pa = "/fragment@41:target:0";
		spi2 = "/fragment@3:target:0";
		subpmic_pmu_eint = "/fragment@40:target:0";
		tcpc_pd = "/fragment@42:target:0";
		touch = "/fragment@39:target:0", "/fragment@56:target:0", "/fragment@62:target:0";
	};

	__local_fixups__ {

		fragment@12 {

			__overlay__ {
				pinctrl-0 = <0x0>;
			};
		};

		fragment@15 {

			__overlay__ {
				pinctrl-0 = <0x0>;
				pinctrl-1 = <0x0>;
				pinctrl-2 = <0x0>;
				pinctrl-3 = <0x0>;
				pinctrl-4 = <0x0>;
				pinctrl-5 = <0x0>;
				pinctrl-6 = <0x0>;
			};
		};

		fragment@16 {

			__overlay__ {
				pinctrl-0 = <0x0>;
				pinctrl-1 = <0x0>;
			};
		};

		fragment@19 {

			__overlay__ {
				pinctrl-0 = <0x0>;
				pinctrl-1 = <0x0>;
				pinctrl-2 = <0x0>;
				pinctrl-3 = <0x0>;
				pinctrl-4 = <0x0>;
			};
		};

		fragment@22 {

			__overlay__ {
				pinctrl-0 = <0x0>;
				pinctrl-1 = <0x0>;
				pinctrl-2 = <0x0>;
			};
		};

		fragment@24 {

			__overlay__ {

				aw36518@63 {
					pinctrl-0 = <0x0>;
					pinctrl-1 = <0x0>;
					pinctrl-2 = <0x0>;
					pinctrl-3 = <0x0>;
					pinctrl-4 = <0x0>;
				};
			};
		};

		fragment@4 {

			__overlay__ {
				pinctrl-0 = <0x0>;
				pinctrl-1 = <0x0>;
				pinctrl-10 = <0x0>;
				pinctrl-11 = <0x0>;
				pinctrl-12 = <0x0>;
				pinctrl-13 = <0x0>;
				pinctrl-2 = <0x0>;
				pinctrl-3 = <0x0>;
				pinctrl-4 = <0x0>;
				pinctrl-5 = <0x0>;
				pinctrl-6 = <0x0>;
				pinctrl-7 = <0x0>;
				pinctrl-8 = <0x0>;
				pinctrl-9 = <0x0>;
			};
		};

		fragment@59 {

			__overlay__ {
				pinctrl-0 = <0x0>;
				pinctrl-1 = <0x0>;
				pinctrl-10 = <0x0>;
				pinctrl-11 = <0x0>;
				pinctrl-12 = <0x0>;
				pinctrl-13 = <0x0>;
				pinctrl-14 = <0x0>;
				pinctrl-15 = <0x0>;
				pinctrl-16 = <0x0>;
				pinctrl-17 = <0x0>;
				pinctrl-18 = <0x0>;
				pinctrl-19 = <0x0>;
				pinctrl-2 = <0x0>;
				pinctrl-20 = <0x0>;
				pinctrl-21 = <0x0>;
				pinctrl-22 = <0x0>;
				pinctrl-23 = <0x0>;
				pinctrl-24 = <0x0>;
				pinctrl-25 = <0x0>;
				pinctrl-26 = <0x0>;
				pinctrl-27 = <0x0>;
				pinctrl-28 = <0x0>;
				pinctrl-29 = <0x0>;
				pinctrl-3 = <0x0>;
				pinctrl-30 = <0x0>;
				pinctrl-31 = <0x0>;
				pinctrl-32 = <0x0>;
				pinctrl-33 = <0x0>;
				pinctrl-4 = <0x0>;
				pinctrl-5 = <0x0>;
				pinctrl-6 = <0x0>;
				pinctrl-7 = <0x0>;
				pinctrl-8 = <0x0>;
				pinctrl-9 = <0x0>;
			};
		};

		fragment@61 {

			__overlay__ {

				tcm_touch@2c {
					pinctrl-0 = <0x0 0x4>;
					pinctrl-1 = <0x0 0x4>;
				};
			};
		};
	};

	__symbols__ {
		aw36518_default = "/fragment@23/__overlay__/aw36518_default";
		aw36518_en_0 = "/fragment@23/__overlay__/aw36518_en_0";
		aw36518_en_1 = "/fragment@23/__overlay__/aw36518_en_1";
		aw36518_strobe_0 = "/fragment@23/__overlay__/aw36518_strobe_0";
		aw36518_strobe_1 = "/fragment@23/__overlay__/aw36518_strobe_1";
		aw881xx_smartpa = "/fragment@2/__overlay__/aw881xx_smartpa@34";
		camera0_mclk_2mA = "/fragment@58/__overlay__/camera0_mclk_2mA@gpio99";
		camera0_mclk_4mA = "/fragment@58/__overlay__/camera0_mclk_4mA@gpio99";
		camera0_mclk_6mA = "/fragment@58/__overlay__/camera0_mclk_6mA@gpio99";
		camera0_mclk_8mA = "/fragment@58/__overlay__/camera0_mclk_8mA@gpio99";
		camera0_mclk_off = "/fragment@58/__overlay__/camera0_mclk_gpio_mode@gpio99";
		camera0_pdn_high = "/fragment@58/__overlay__/camera0_pdn_output_high@gpio107";
		camera0_pdn_low = "/fragment@58/__overlay__/camera0_pdn_output_low@gpio107";
		camera0_rst_high = "/fragment@58/__overlay__/camera0_rst_output_high@gpio109";
		camera0_rst_low = "/fragment@58/__overlay__/camera0_rst_output_low@gpio109";
		camera0_vcama_off = "/fragment@58/__overlay__/camera0_vcama_output_low@gpio178";
		camera0_vcama_on = "/fragment@58/__overlay__/camera0_vcama_output_high@gpio79";
		camera0_vcamd_off = "/fragment@58/__overlay__/camera0_vcamd_output_low@gpio80";
		camera0_vcamd_on = "/fragment@58/__overlay__/camera0_vcamd_output_high@gpio80";
		camera1_mclk_2mA = "/fragment@58/__overlay__/camera1_mclk_2mA@gpio100";
		camera1_mclk_4mA = "/fragment@58/__overlay__/camera1_mclk_4mA@gpio100";
		camera1_mclk_6mA = "/fragment@58/__overlay__/camera1_mclk_6mA@gpio100";
		camera1_mclk_8mA = "/fragment@58/__overlay__/camera1_mclk_8mA@gpio100";
		camera1_mclk_off = "/fragment@58/__overlay__/camera1_mclk_gpio_mode@gpio100";
		camera1_pdn_high = "/fragment@58/__overlay__/camera1_pdn_output_high@gpio98";
		camera1_pdn_low = "/fragment@58/__overlay__/camera1_pdn_output_low@gpio98";
		camera1_rst_high = "/fragment@58/__overlay__/camera1_rst_output_high@gpio102";
		camera1_rst_low = "/fragment@58/__overlay__/camera1_rst_output_low@gpio102";
		camera1_vcamd_off = "/fragment@58/__overlay__/camera1_vcamd_output_low@gpio31";
		camera1_vcamd_on = "/fragment@58/__overlay__/camera1_vcamd_output_high@gpio31";
		camera2_mclk_2mA = "/fragment@58/__overlay__/camera2_mclk_2mA@gpio99";
		camera2_mclk_4mA = "/fragment@58/__overlay__/camera2_mclk_4mA@gpio99";
		camera2_mclk_6mA = "/fragment@58/__overlay__/camera2_mclk_6mA@gpio99";
		camera2_mclk_8mA = "/fragment@58/__overlay__/camera2_mclk_8mA@gpio99";
		camera2_mclk_off = "/fragment@58/__overlay__/camera2_mclk_gpio_mode@gpio99";
		camera2_pdn_high = "/fragment@58/__overlay__/camera2_pdn_output_high@gpio14";
		camera2_pdn_low = "/fragment@58/__overlay__/camera2_pdn_output_low@gpio14";
		camera2_rst_high = "/fragment@58/__overlay__/camera2_rst_output_high@gpio16";
		camera2_rst_low = "/fragment@58/__overlay__/camera2_rst_output_low@gpio16";
		camera2_vcama_off = "/fragment@58/__overlay__/camera2_vcama_output_low@gpio107";
		camera_main_af_mtk = "/fragment@30/__overlay__/camera_main_af@0c";
		camera_main_eeprom_mtk = "/fragment@30/__overlay__/camera_main_eeprom@50";
		camera_main_mtk = "/fragment@30/__overlay__/camera_main@1a";
		camera_main_two_af_mtk = "/fragment@30/__overlay__/camera_main_two_af@1c";
		camera_main_two_eeprom_mtk = "/fragment@30/__overlay__/camera_main_two_eeprom@51";
		camera_main_two_mtk = "/fragment@30/__overlay__/camera_main_two@10";
		camera_pins_default = "/fragment@58/__overlay__/camdefault";
		camera_sub_eeprom_mtk = "/fragment@32/__overlay__/camera_sub_eeprom@52";
		camera_sub_mtk = "/fragment@32/__overlay__/camera_sub@2d";
		cap_touch_mtk = "/fragment@28/__overlay__/cap_touch@14";
		ccu_sensor_i2c_2_hw_mtk = "/fragment@30/__overlay__/ccu_sensor_i2c_2_hw@11";
		ccu_sensor_i2c_4_hw_mtk = "/fragment@32/__overlay__/ccu_sensor_i2c_4_hw@12";
		consys_pins_default = "/fragment@14/__overlay__/consys_default";
		ctp_pins_default = "/fragment@63/__overlay__/eintdefault";
		ctp_ts_i2c_mode = "/fragment@63/__overlay__/i2cmode_default";
		ctp_ts_int_active = "/fragment@63/__overlay__/int_active";
		ctp_ts_int_as_gpio = "/fragment@63/__overlay__/int_high";
		ctp_ts_int_suspend = "/fragment@63/__overlay__/int_suspend";
		ctp_ts_reset_active = "/fragment@63/__overlay__/reset_active";
		ctp_ts_reset_suspend = "/fragment@63/__overlay__/reset_suspend";
		fingerprint = "/fragment@3/__overlay__/fingerprint@spi2";
		fmlna_pins_init = "/fragment@14/__overlay__/fmlna@0";
		fmlna_pins_oh = "/fragment@14/__overlay__/fmlna@1";
		fmlna_pins_ol = "/fragment@14/__overlay__/fmlna@2";
		fpc_miso_pull_down = "/fragment@5/__overlay__/fpcmisolow";
		fpc_miso_pull_up = "/fragment@5/__overlay__/fpcmisoup";
		fpc_mode_as_ck = "/fragment@5/__overlay__/fpcck";
		fpc_mode_as_cs = "/fragment@5/__overlay__/fpccs";
		fpc_mode_as_mi = "/fragment@5/__overlay__/fpcmi";
		fpc_mode_as_mo = "/fragment@5/__overlay__/fpcmo";
		fpc_mosi_pull_down = "/fragment@5/__overlay__/fpcmosilow";
		fpc_mosi_pull_up = "/fragment@5/__overlay__/fpcmosiup";
		fpc_pins_default = "/fragment@5/__overlay__/fpcdefault";
		fpc_pins_eint_as_int = "/fragment@5/__overlay__/fpceint@0";
		fpc_pins_pwr_high = "/fragment@5/__overlay__/fpcpwrhigh";
		fpc_pins_pwr_low = "/fragment@5/__overlay__/fpcpwrlow";
		fpc_pins_rst_high = "/fragment@5/__overlay__/fpcrsthigh";
		fpc_pins_rst_low = "/fragment@5/__overlay__/fpcrstlow";
		gpslna_pins_init = "/fragment@14/__overlay__/gpslna@0";
		gpslna_pins_oh = "/fragment@14/__overlay__/gpslna@1";
		gpslna_pins_ol = "/fragment@14/__overlay__/gpslna@2";
		irq_nfc = "/fragment@9/__overlay__/irq_nfc";
		irtx_gpio_led_default = "/fragment@17/__overlay__/irtx_gpio_led_def@gpio12";
		irtx_gpio_led_set = "/fragment@17/__overlay__/irtx_gpio_led_set@gpio12";
		kpd_pins_default = "/fragment@13/__overlay__/kpdgpiodefault";
		lcd_bias_pins_default = "/fragment@18/__overlay__/default";
		lcd_bias_pins_enn0 = "/fragment@18/__overlay__/lcdbias_enn_low";
		lcd_bias_pins_enn1 = "/fragment@18/__overlay__/lcdbias_enn_high";
		lcd_bias_pins_enp0 = "/fragment@18/__overlay__/lcdbias_enp_low";
		lcd_bias_pins_enp1 = "/fragment@18/__overlay__/lcdbias_enp_high";
		led0 = "/fragment@6/__overlay__/led@0";
		led1 = "/fragment@6/__overlay__/led@1";
		led2 = "/fragment@6/__overlay__/led@2";
		led3 = "/fragment@6/__overlay__/led@3";
		led4 = "/fragment@6/__overlay__/led@4";
		led5 = "/fragment@6/__overlay__/led@5";
		led6 = "/fragment@6/__overlay__/led@6";
		mtkfb_pins_lcm_dsi_te = "/fragment@21/__overlay__/lcm_dsi_te";
		mtkfb_pins_lcm_rst_out0_gpio = "/fragment@21/__overlay__/lcm_rst_out0_gpio";
		mtkfb_pins_lcm_rst_out1_gpio = "/fragment@21/__overlay__/lcm_rst_out1_gpio";
		nfc = "/fragment@9/__overlay__/nfc";
		nfc_mtk = "/fragment@31/__overlay__/nfc@08";
		nfc_st = "/fragment@10/__overlay__/nfc@08";
		slave_charger_mtk = "/fragment@35/__overlay__/slave_charger@4b";
		speaker_amp_mtk = "/fragment@35/__overlay__/speaker_amp@34";
		usb_type_c_mtk = "/fragment@34/__overlay__/usb_type_c@4e";
		vibrator0 = "/fragment@6/__overlay__/vibrator@0";
	};

	fragment@0 {
		target = <0xffffffff>;

		__overlay__ {

			reserve-memory-scp_share {
				alignment = <0x0 0x1000000>;
				alloc-ranges = <0x0 0x40000000 0x0 0x50000000>;
				compatible = "mediatek,reserve-memory-scp_share";
				no-map;
				size = <0x0 0xd00000>;
			};
		};
	};

	fragment@1 {
		target = <0xffffffff>;

		__overlay__ {
			atag,videolfb-fb_base_h = <0x0>;
			atag,videolfb-fb_base_l = "~`P";
			atag,videolfb-fps = <0x1770>;
			atag,videolfb-islcm_inited = <0x0>;
			atag,videolfb-islcmfound = <0x1>;
			atag,videolfb-lcmname = "hx83112b_fhdp_dsi_cmd_auo_rt5081_drv";
			atag,videolfb-vramSize = <0x17e8000>;
		};
	};

	fragment@10 {
		target = <0xffffffff>;

		__overlay__ {

			nfc@08 {
				compatible = "mediatek,nfc";
				phandle = <0x58>;
				reg = <0x8>;
				status = "okay";
			};
		};
	};

	fragment@11 {
		target = <0xffffffff>;

		__overlay__ {
			accdet-mic-mode = <0x1>;
			accdet-mic-vol = <0x6>;
			accdet-plugout-debounce = <0x1>;
			headset-eint-level-pol = <0x8>;
			headset-four-key-threshold = <0x0 0x3a 0x79 0xc0 0x190>;
			headset-mode-setting = <0x500 0x500 0x1 0x1f0 0x800 0x800 0x20 0x44>;
			headset-three-key-threshold = <0x0 0x50 0xdc 0x190>;
			headset-three-key-threshold-CDD = <0x0 0x79 0xc0 0x258>;
			status = "okay";
		};
	};

	fragment@12 {
		target = <0xffffffff>;

		__overlay__ {
			pinctrl-0 = <0xf>;
			pinctrl-names = "default";
		};
	};

	fragment@13 {
		target = <0xffffffff>;

		__overlay__ {

			kpdgpiodefault {
				phandle = <0xf>;

				pins_cmd_dat {
					bias-pull-up = <0x66>;
					input-enable;
					input-schmitt-enable;
					pinmux = <0x5d01>;
				};
			};
		};
	};

	fragment@14 {
		target = <0xffffffff>;

		__overlay__ {

			consys_default {
				phandle = <0x10>;
			};

			fmlna@0 {
				phandle = <0x14>;

				pins_cmd_dat {
					bias-disable;
					output-low;
					pinmux = <0x1d00>;
					slew-rate = <0x0>;
				};
			};

			fmlna@1 {
				phandle = <0x15>;

				pins_cmd_dat {
					output-high;
					pinmux = <0x1d00>;
					slew-rate = <0x1>;
				};
			};

			fmlna@2 {
				phandle = <0x16>;

				pins_cmd_dat {
					output-low;
					pinmux = <0x1d00>;
					slew-rate = <0x1>;
				};
			};

			gpslna@0 {
				phandle = <0x11>;

				pins_cmd_dat {
					bias-disable;
					output-low;
					pinmux = <0x9700>;
					slew-rate = <0x0>;
				};
			};

			gpslna@1 {
				phandle = <0x12>;

				pins_cmd_dat {
					output-high;
					pinmux = <0x9700>;
					slew-rate = <0x1>;
				};
			};

			gpslna@2 {
				phandle = <0x13>;

				pins_cmd_dat {
					output-low;
					pinmux = <0x9700>;
					slew-rate = <0x1>;
				};
			};
		};
	};

	fragment@15 {
		target = <0xffffffff>;

		__overlay__ {
			pinctrl-0 = <0x10>;
			pinctrl-1 = <0x11>;
			pinctrl-2 = <0x12>;
			pinctrl-3 = <0x13>;
			pinctrl-4 = <0x14>;
			pinctrl-5 = <0x15>;
			pinctrl-6 = <0x16>;
			pinctrl-names = "default", "gps_lna_state_init", "gps_lna_state_oh", "gps_lna_state_ol", "fm_lna_state_init", "fm_lna_state_oh", "fm_lna_state_ol";
			status = "okay";
		};
	};

	fragment@16 {
		target = <0xffffffff>;

		__overlay__ {
			pinctrl-0 = <0x17>;
			pinctrl-1 = <0x18>;
			pinctrl-names = "irtx_gpio_led_default", "irtx_gpio_led_set";
			status = "okay";
		};
	};

	fragment@17 {
		target = <0xffffffff>;

		__overlay__ {

			irtx_gpio_led_def@gpio12 {
				phandle = <0x17>;

				pins_cmd_dat {
					bias-disable;
					input-schmitt-enable = <0x0>;
					output-low;
					pinmux = <0xc00>;
					slew-rate = <0x1>;
				};
			};

			irtx_gpio_led_set@gpio12 {
				phandle = <0x18>;

				pins_cmd_dat {
					output-high;
					pinmux = <0xc01>;
					slew-rate = <0x1>;
				};
			};
		};
	};

	fragment@18 {
		target = <0xffffffff>;

		__overlay__ {

			default {
				phandle = <0x19>;
			};

			lcdbias_enn_high {
				phandle = <0x1c>;

				pins_cmd_dat {
					output-high;
					pinmux = <0xa500>;
					slew-rate = <0x1>;
				};
			};

			lcdbias_enn_low {
				phandle = <0x1d>;

				pins_cmd_dat {
					output-low;
					pinmux = <0xa500>;
					slew-rate = <0x1>;
				};
			};

			lcdbias_enp_high {
				phandle = <0x1a>;

				pins_cmd_dat {
					output-high;
					pinmux = <0xa900>;
					slew-rate = <0x1>;
				};
			};

			lcdbias_enp_low {
				phandle = <0x1b>;

				pins_cmd_dat {
					output-low;
					pinmux = <0xa900>;
					slew-rate = <0x1>;
				};
			};
		};
	};

	fragment@19 {
		target = <0xffffffff>;

		__overlay__ {
			pinctrl-0 = <0x19>;
			pinctrl-1 = <0x1a>;
			pinctrl-2 = <0x1b>;
			pinctrl-3 = <0x1c>;
			pinctrl-4 = <0x1d>;
			pinctrl-names = "default", "lcdbias_enp_high", "lcdbias_enp_low", "lcdbias_enn_high", "lcdbias_enn_low";
		};
	};

	fragment@2 {
		target = <0xffffffff>;

		__overlay__ {

			aw881xx_smartpa@34 {
				compatible = "mediatek,aw881xx_smartpa";
				irq-gpio = <0xffffffff 0x27 0x0>;
				phandle = <0x4c>;
				reg = <0x34>;
				reset-gpio = <0xffffffff 0x1e 0x0>;
				status = "okay";
			};
		};
	};

	fragment@20 {
		target = <0xffffffff>;

		__overlay__ {

			aw2016@64 {
				compatible = "awinic,aw2016_led";
				reg = <0x64>;

				aw2016,green {
					aw2016,fall-time-ms = <0x1>;
					aw2016,hold-time-ms = <0x2>;
					aw2016,id = <0x1>;
					aw2016,imax = <0x0>;
					aw2016,led-current = <0xa>;
					aw2016,max-brightness = <0xff>;
					aw2016,name = "green";
					aw2016,off-time-ms = <0x8>;
					aw2016,rise-time-ms = <0x1>;
				};

				aw2016,red {
					aw2016,fall-time-ms = <0x0>;
					aw2016,hold-time-ms = <0x4>;
					aw2016,id = <0x0>;
					aw2016,imax = <0x5>;
					aw2016,led-current = <0x5>;
					aw2016,max-brightness = <0xff>;
					aw2016,name = "red";
					aw2016,off-time-ms = <0x8>;
					aw2016,rise-time-ms = <0x0>;
				};
			};
		};
	};

	fragment@21 {
		target = <0xffffffff>;

		__overlay__ {

			lcm_dsi_te {
				phandle = <0x20>;

				pins_cmd_dat {
					pinmux = <0x2c01>;
				};
			};

			lcm_rst_out0_gpio {
				phandle = <0x1f>;

				pins_cmd_dat {
					output-low;
					pinmux = <0x2d00>;
					slew-rate = <0x1>;
				};
			};

			lcm_rst_out1_gpio {
				phandle = <0x1e>;

				pins_cmd_dat {
					output-high;
					pinmux = <0x2d00>;
					slew-rate = <0x1>;
				};
			};
		};
	};

	fragment@22 {
		target = <0xffffffff>;

		__overlay__ {
			pinctrl-0 = <0x1e>;
			pinctrl-1 = <0x1f>;
			pinctrl-2 = <0x20>;
			pinctrl-names = "lcm_rst_out1_gpio", "lcm_rst_out0_gpio", "mode_te_te";
			status = "okay";
		};
	};

	fragment@23 {
		target = <0xffffffff>;

		__overlay__ {

			aw36518_default {
				phandle = <0x21>;
			};

			aw36518_en_0 {
				phandle = <0x24>;

				pins_cmd_dat {
					output-low;
					pinmux = <0x9800>;
					slew-rate = <0x1>;
				};
			};

			aw36518_en_1 {
				phandle = <0x25>;

				pins_cmd_dat {
					output-high;
					pinmux = <0x9800>;
					slew-rate = <0x1>;
				};
			};

			aw36518_strobe_0 {
				phandle = <0x22>;

				pins_cmd_dat {
					output-low;
					pinmux = <0x9900>;
					slew-rate = <0x1>;
				};
			};

			aw36518_strobe_1 {
				phandle = <0x23>;

				pins_cmd_dat {
					output-high;
					pinmux = <0x9900>;
					slew-rate = <0x1>;
				};
			};
		};
	};

	fragment@24 {
		target = <0xffffffff>;

		__overlay__ {

			aw36518@63 {
				compatible = "mediatek,flashlights_aw36518";
				pinctrl-0 = <0x21>;
				pinctrl-1 = <0x22>;
				pinctrl-2 = <0x23>;
				pinctrl-3 = <0x24>;
				pinctrl-4 = <0x25>;
				pinctrl-names = "aw36518_default", "aw36518_strobe_0", "aw36518_strobe_1", "aw36518_en_0", "aw36518_en_1";
				reg = <0x63>;
				status = "okay";
			};
		};
	};

	fragment@25 {
		target = <0xffffffff>;

		__overlay__ {

			adc_channel@ {
				compatible = "mediatek,adc_channel";
				mediatek,adc_fdd_rf_params_dynamic_custom_ch = <0x2>;
				mediatek,temperature0 = <0x0>;
				mediatek,temperature1 = <0x1>;
				status = "okay";
			};
		};
	};

	fragment@26 {
		target = <0xffffffff>;

		__overlay__ {
			io-channels = <0xffffffff 0x2>;
		};
	};

	fragment@27 {
		target = <0xffffffff>;

		__overlay__ {
			mediatek,clkbuf-config = <0x2 0x1 0x1 0x2 0x0 0x0 0x0>;
			mediatek,clkbuf-driving-current = <0x1 0x1 0x1 0x1 0x1 0x1 0x1>;
			mediatek,clkbuf-quantity = <0x7>;
			status = "okay";
		};
	};

	fragment@28 {
		target = <0xffffffff>;

		__overlay__ {
			#address-cells = <0x1>;
			#size-cells = <0x0>;
			clock-frequency = <0x61a80>;
			mediatek,use-open-drain;

			cap_touch@14 {
				compatible = "mediatek,cap_touch";
				phandle = <0x59>;
				reg = <0x14>;
				status = "okay";
			};
		};
	};

	fragment@29 {
		target = <0xffffffff>;

		__overlay__ {
			#address-cells = <0x1>;
			#size-cells = <0x0>;
			clock-frequency = <0x61a80>;
			mediatek,use-open-drain;
		};
	};

	fragment@3 {
		target = <0xffffffff>;

		__overlay__ {
			#address-cells = <0x1>;
			#size-cells = <0x0>;

			fingerprint@spi2 {
				compatible = "focaltech,fingerprint-spidev";
				phandle = <0x4d>;
				reg = <0x0>;
				spi-max-frequency = <0xf4240>;
				status = "okay";
			};
		};
	};

	fragment@30 {
		target = <0xffffffff>;

		__overlay__ {
			#address-cells = <0x1>;
			#size-cells = <0x0>;
			clock-frequency = <0x61a80>;
			mediatek,use-open-drain;

			camera_main@1a {
				compatible = "mediatek,camera_main";
				phandle = <0x5a>;
				reg = <0x1a>;
				status = "okay";
			};

			camera_main_af@0c {
				compatible = "mediatek,camera_main_af";
				phandle = <0x5c>;
				reg = <0xc>;
				status = "okay";
			};

			camera_main_eeprom@50 {
				compatible = "mediatek,camera_main_eeprom";
				phandle = <0x5b>;
				reg = <0x50>;
				status = "okay";
			};

			camera_main_two@10 {
				compatible = "mediatek,camera_main_two";
				phandle = <0x5d>;
				reg = <0x10>;
				status = "okay";
			};

			camera_main_two_af@1c {
				compatible = "mediatek,camera_main_two_af";
				phandle = <0x60>;
				reg = <0x1c>;
				status = "okay";
			};

			camera_main_two_eeprom@51 {
				compatible = "mediatek,camera_main_two_eeprom";
				phandle = <0x5e>;
				reg = <0x51>;
				status = "okay";
			};

			ccu_sensor_i2c_2_hw@11 {
				compatible = "mediatek,ccu_sensor_i2c_2_hw";
				phandle = <0x5f>;
				reg = <0x11>;
				status = "okay";
			};
		};
	};

	fragment@31 {
		target = <0xffffffff>;

		__overlay__ {
			#address-cells = <0x1>;
			#size-cells = <0x0>;
			clock-frequency = <0x61a80>;
			mediatek,use-open-drain;

			nfc@08 {
				compatible = "mediatek,nfc";
				phandle = <0x61>;
				reg = <0x8>;
				status = "okay";
			};
		};
	};

	fragment@32 {
		target = <0xffffffff>;

		__overlay__ {
			#address-cells = <0x1>;
			#size-cells = <0x0>;
			clock-frequency = <0x61a80>;
			mediatek,use-open-drain;

			camera_sub@2d {
				compatible = "mediatek,camera_sub";
				phandle = <0x62>;
				reg = <0x2d>;
				status = "okay";
			};

			camera_sub_eeprom@52 {
				compatible = "mediatek,camera_sub_eeprom";
				phandle = <0x63>;
				reg = <0x52>;
				status = "okay";
			};

			ccu_sensor_i2c_4_hw@12 {
				compatible = "mediatek,ccu_sensor_i2c_4_hw";
				phandle = <0x64>;
				reg = <0x12>;
				status = "okay";
			};
		};
	};

	fragment@33 {
		target = <0xffffffff>;

		__overlay__ {
			#address-cells = <0x1>;
			#size-cells = <0x0>;
			clock-frequency = <0x61a80>;
			mediatek,use-open-drain;
		};
	};

	fragment@34 {
		target = <0xffffffff>;

		__overlay__ {
			#address-cells = <0x1>;
			#size-cells = <0x0>;
			clock-frequency = <0x61a80>;
			mediatek,use-open-drain;

			usb_type_c@4e {
				compatible = "mediatek,usb_type_c";
				phandle = <0x65>;
				reg = <0x4e>;
				status = "okay";
			};
		};
	};

	fragment@35 {
		target = <0xffffffff>;

		__overlay__ {
			#address-cells = <0x1>;
			#size-cells = <0x0>;
			clock-frequency = <0x61a80>;
			mediatek,use-open-drain;

			slave_charger@4b {
				compatible = "mediatek,slave_charger";
				phandle = <0x67>;
				reg = <0x4b>;
				status = "okay";
			};

			speaker_amp@34 {
				compatible = "mediatek,speaker_amp";
				phandle = <0x66>;
				reg = <0x34>;
				status = "okay";
			};
		};
	};

	fragment@36 {
		target = <0xffffffff>;

		__overlay__ {
			#address-cells = <0x1>;
			#size-cells = <0x0>;
			clock-frequency = <0x61a80>;
			mediatek,use-open-drain;
		};
	};

	fragment@37 {
		target = <0xffffffff>;

		__overlay__ {
			GPIO_SIM1_HOT_PLUG = <0xffffffff 0x2f 0x0>;
			GPIO_SIM1_SCLK = <0xffffffff 0xac 0x0>;
			GPIO_SIM1_SIO = <0xffffffff 0xae 0x0>;
			GPIO_SIM1_SRST = <0xffffffff 0xad 0x0>;
			GPIO_SIM2_HOT_PLUG = <0xffffffff 0x2e 0x0>;
			GPIO_SIM2_SCLK = <0xffffffff 0x9d 0x0>;
			GPIO_SIM2_SIO = <0xffffffff 0x9b 0x0>;
			GPIO_SIM2_SRST = <0xffffffff 0x9c 0x0>;
		};
	};

	fragment@38 {
		target = <0xffffffff>;

		__overlay__ {
			gpio_init_default = <0x0 0x0 0x1 0x0 0x1 0x0 0x1 0x1 0x0 0x0 0x0 0x1 0x1 0x1 0x2 0x0 0x0 0x0 0x0 0x0 0x1 0x3 0x0 0x0 0x0 0x1 0x0 0x1 0x4 0x0 0x0 0x0 0x0 0x0 0x0 0x5 0x0 0x0 0x0 0x1 0x0 0x0 0x6 0x0 0x0 0x0 0x1 0x1 0x0 0x7 0x0 0x0 0x0 0x1 0x0 0x0 0x8 0x0 0x1 0x0 0x0 0x0 0x0 0x9 0x0 0x0 0x0 0x1 0x0 0x0 0xa 0x0 0x0 0x0 0x1 0x1 0x0 0xb 0x1 0x0 0x0 0x1 0x0 0x0 0xc 0x0 0x0 0x0 0x1 0x0 0x0 0xd 0x0 0x1 0x0 0x1 0x1 0x0 0xe 0x0 0x1 0x0 0x1 0x1 0x0 0xf 0x0 0x1 0x0 0x1 0x1 0x0 0x10 0x0 0x1 0x0 0x1 0x1 0x0 0x11 0x0 0x1 0x0 0x1 0x1 0x1 0x12 0x0 0x0 0x0 0x1 0x1 0x1 0x13 0x0 0x0 0x0 0x1 0x1 0x1 0x14 0x0 0x0 0x0 0x1 0x1 0x1 0x15 0x0 0x1 0x0 0x1 0x1 0x0 0x16 0x0 0x0 0x0 0x1 0x1 0x0 0x17 0x0 0x1 0x0 0x0 0x0 0x0 0x18 0x0 0x1 0x0 0x0 0x0 0x0 0x19 0x2 0x1 0x0 0x1 0x0 0x0 0x1a 0x2 0x1 0x0 0x0 0x0 0x0 0x1b 0x2 0x1 0x0 0x1 0x0 0x0 0x1c 0x2 0x0 0x0 0x1 0x0 0x0 0x1d 0x0 0x1 0x0 0x0 0x0 0x0 0x1e 0x0 0x1 0x0 0x0 0x0 0x0 0x1f 0x0 0x1 0x0 0x0 0x0 0x0 0x20 0x1 0x0 0x0 0x1 0x0 0x0 0x21 0x1 0x0 0x0 0x1 0x0 0x0 0x22 0x1 0x1 0x0 0x1 0x0 0x0 0x23 0x1 0x1 0x0 0x0 0x0 0x0 0x24 0x1 0x1 0x0 0x0 0x0 0x0 0x25 0x1 0x1 0x0 0x0 0x0 0x0 0x26 0x1 0x1 0x0 0x0 0x0 0x0 0x27 0x0 0x0 0x0 0x1 0x1 0x1 0x28 0x1 0x0 0x0 0x1 0x0 0x0 0x29 0x0 0x0 0x0 0x0 0x0 0x1 0x2a 0x0 0x0 0x0 0x1 0x0 0x1 0x2b 0x1 0x1 0x0 0x0 0x0 0x0 0x2c 0x1 0x0 0x0 0x1 0x0 0x0 0x2d 0x0 0x1 0x0 0x0 0x0 0x0 0x2e 0x1 0x0 0x0 0x1 0x1 0x0 0x2f 0x1 0x0 0x0 0x1 0x1 0x0 0x30 0x1 0x0 0x0 0x1 0x1 0x1 0x31 0x1 0x0 0x0 0x1 0x1 0x1 0x32 0x1 0x0 0x0 0x1 0x1 0x1 0x33 0x1 0x0 0x0 0x1 0x1 0x1 0x34 0x0 0x1 0x0 0x1 0x0 0x0 0x35 0x1 0x0 0x0 0x1 0x0 0x0 0x36 0x1 0x0 0x0 0x1 0x0 0x0 0x37 0x1 0x0 0x0 0x1 0x0 0x0 0x38 0x1 0x0 0x0 0x1 0x0 0x0 0x39 0x1 0x0 0x0 0x1 0x0 0x0 0x3a 0x0 0x0 0x0 0x1 0x0 0x0 0x3b 0x1 0x0 0x0 0x1 0x0 0x0 0x3c 0x1 0x0 0x0 0x1 0x0 0x0 0x3d 0x1 0x0 0x0 0x1 0x0 0x0 0x3e 0x1 0x0 0x0 0x1 0x0 0x0 0x3f 0x1 0x0 0x0 0x1 0x0 0x0 0x40 0x1 0x0 0x0 0x1 0x0 0x0 0x41 0x1 0x0 0x0 0x1 0x0 0x0 0x42 0x1 0x0 0x0 0x1 0x0 0x0 0x43 0x1 0x0 0x0 0x1 0x0 0x0 0x44 0x1 0x0 0x0 0x1 0x0 0x0 0x45 0x1 0x0 0x0 0x1 0x0 0x0 0x46 0x1 0x0 0x0 0x1 0x0 0x0 0x47 0x1 0x0 0x0 0x1 0x0 0x0 0x48 0x1 0x0 0x0 0x1 0x0 0x0 0x49 0x1 0x0 0x0 0x1 0x0 0x0 0x4a 0x1 0x0 0x0 0x1 0x0 0x0 0x4b 0x1 0x0 0x0 0x1 0x0 0x0 0x4c 0x1 0x0 0x0 0x1 0x0 0x0 0x4d 0x1 0x0 0x0 0x1 0x0 0x0 0x4e 0x1 0x0 0x0 0x1 0x0 0x0 0x4f 0x0 0x1 0x0 0x0 0x0 0x0 0x50 0x0 0x1 0x0 0x0 0x0 0x0 0x51 0x2 0x0 0x0 0x1 0x1 0x1 0x52 0x1 0x0 0x0 0x1 0x1 0x1 0x53 0x1 0x0 0x0 0x1 0x1 0x1 0x54 0x2 0x0 0x0 0x1 0x1 0x1 0x55 0x2 0x0 0x0 0x1 0x0 0x0 0x56 0x2 0x1 0x0 0x0 0x0 0x0 0x57 0x2 0x1 0x0 0x0 0x0 0x0 0x58 0x2 0x1 0x0 0x0 0x0 0x0 0x59 0x1 0x0 0x0 0x1 0x1 0x1 0x5a 0x1 0x0 0x0 0x1 0x1 0x1 0x5b 0x0 0x1 0x0 0x0 0x0 0x0 0x5c 0x0 0x1 0x0 0x0 0x0 0x0 0x5d 0x1 0x0 0x0 0x1 0x1 0x0 0x5e 0x1 0x0 0x0 0x1 0x1 0x0 0x5f 0x1 0x0 0x0 0x1 0x1 0x0 0x60 0x1 0x1 0x0 0x0 0x0 0x0 0x61 0x0 0x1 0x0 0x0 0x0 0x0 0x62 0x0 0x1 0x0 0x0 0x0 0x0 0x63 0x1 0x1 0x0 0x0 0x0 0x0 0x64 0x1 0x1 0x0 0x0 0x0 0x0 0x65 0x0 0x1 0x0 0x0 0x0 0x0 0x66 0x0 0x1 0x0 0x0 0x0 0x0 0x67 0x1 0x0 0x0 0x1 0x1 0x1 0x68 0x1 0x0 0x0 0x1 0x1 0x1 0x69 0x1 0x0 0x0 0x1 0x1 0x1 0x6a 0x1 0x0 0x0 0x1 0x1 0x1 0x6b 0x0 0x1 0x0 0x0 0x0 0x0 0x6c 0x1 0x1 0x0 0x0 0x0 0x0 0x6d 0x0 0x1 0x0 0x0 0x0 0x0 0x6e 0x0 0x1 0x0 0x0 0x0 0x0 0x6f 0x1 0x1 0x0 0x0 0x0 0x0 0x70 0x0 0x0 0x0 0x0 0x0 0x0 0x71 0x0 0x0 0x0 0x1 0x0 0x0 0x72 0x0 0x0 0x0 0x1 0x0 0x0 0x73 0x0 0x0 0x0 0x1 0x0 0x0 0x74 0x0 0x0 0x0 0x1 0x0 0x0 0x75 0x0 0x0 0x0 0x1 0x0 0x0 0x76 0x0 0x0 0x0 0x1 0x0 0x0 0x77 0x0 0x0 0x0 0x1 0x0 0x0 0x78 0x0 0x0 0x0 0x1 0x0 0x0 0x79 0x0 0x0 0x0 0x1 0x0 0x0 0x86 0x1 0x0 0x0 0x1 0x0 0x1 0x87 0x1 0x1 0x0 0x0 0x0 0x0 0x88 0x1 0x1 0x0 0x0 0x0 0x0 0x89 0x1 0x1 0x0 0x0 0x0 0x0 0x8a 0x1 0x1 0x0 0x0 0x0 0x0 0x8b 0x1 0x1 0x0 0x0 0x0 0x0 0x8c 0x1 0x0 0x0 0x1 0x0 0x0 0x8d 0x1 0x0 0x0 0x1 0x0 0x0 0x8e 0x1 0x0 0x0 0x1 0x0 0x0 0x8f 0x1 0x0 0x0 0x1 0x0 0x0 0x90 0x1 0x0 0x0 0x1 0x0 0x0 0x91 0x1 0x1 0x0 0x0 0x0 0x0 0x92 0x1 0x1 0x0 0x0 0x0 0x0 0x93 0x1 0x1 0x0 0x0 0x0 0x0 0x94 0x1 0x1 0x0 0x0 0x0 0x0 0x95 0x1 0x1 0x0 0x0 0x0 0x0 0x96 0x0 0x1 0x0 0x0 0x0 0x0 0x97 0x0 0x1 0x0 0x0 0x0 0x0 0x98 0x0 0x1 0x0 0x0 0x0 0x0 0x99 0x0 0x1 0x0 0x0 0x0 0x0 0x9a 0x1 0x1 0x0 0x0 0x0 0x0 0x9b 0x1 0x0 0x0 0x1 0x1 0x0 0x9c 0x1 0x1 0x0 0x0 0x0 0x0 0x9d 0x1 0x1 0x0 0x0 0x0 0x0 0x9e 0x0 0x1 0x0 0x0 0x0 0x0 0x9f 0x0 0x1 0x0 0x0 0x0 0x0 0xa0 0x0 0x1 0x0 0x0 0x0 0x0 0xa1 0x1 0x0 0x0 0x1 0x1 0x1 0xa2 0x1 0x0 0x0 0x1 0x1 0x1 0xa3 0x1 0x0 0x0 0x1 0x1 0x1 0xa4 0x1 0x0 0x0 0x1 0x1 0x1 0xa5 0x0 0x1 0x0 0x0 0x0 0x0 0xa6 0x0 0x1 0x0 0x0 0x0 0x0 0xa7 0x1 0x0 0x0 0x1 0x0 0x0 0xa8 0x1 0x0 0x0 0x1 0x0 0x0 0xa9 0x0 0x1 0x0 0x0 0x0 0x0 0xaa 0x1 0x0 0x0 0x1 0x1 0x1 0xab 0x1 0x1 0x0 0x0 0x0 0x1 0xac 0x1 0x1 0x0 0x0 0x0 0x0 0xad 0x1 0x1 0x0 0x0 0x0 0x0 0xae 0x1 0x0 0x0 0x1 0x1 0x0 0xaf 0x1 0x0 0x0 0x1 0x1 0x1 0xb0 0x1 0x0 0x0 0x1 0x1 0x1 0xb2 0x0 0x1 0x0 0x0 0x0 0x0 0xb3 0x0 0x1 0x0 0x0 0x0 0x0 0xb4 0x0 0x0 0x0 0x1 0x0 0x0 0xb5 0x0 0x0 0x0 0x1 0x0 0x0 0xb6 0x0 0x0 0x0 0x1 0x0 0x0 0xb7 0x0 0x0 0x0 0x1 0x0 0x0 0xb8 0x0 0x0 0x0 0x1 0x0 0x0 0xb9 0x0 0x0 0x0 0x1 0x0 0x0 0xba 0x0 0x0 0x0 0x1 0x0 0x0>;
		};
	};

	fragment@39 {
		target = <0xffffffff>;

		__overlay__ {
			interrupt-parent = <0xffffffff>;
			interrupts = <0x1 0x2 0x1 0x0>;
			status = "okay";
		};
	};

	fragment@4 {
		target = <0xffffffff>;

		__overlay__ {
			interrupt-parent = <0xffffffff>;
			interrupts = <0x5 0x2 0x5 0x0>;
			pinctrl-0 = <0x1>;
			pinctrl-1 = <0x2>;
			pinctrl-10 = <0xb>;
			pinctrl-11 = <0xc>;
			pinctrl-12 = <0xd>;
			pinctrl-13 = <0xe>;
			pinctrl-2 = <0x3>;
			pinctrl-3 = <0x4>;
			pinctrl-4 = <0x5>;
			pinctrl-5 = <0x6>;
			pinctrl-6 = <0x7>;
			pinctrl-7 = <0x8>;
			pinctrl-8 = <0x9>;
			pinctrl-9 = <0xa>;
			pinctrl-names = "default", "fpc_eint_as_int", "fpc_pins_rst_high", "fpc_pins_rst_low", "fpc_pins_pwr_high", "fpc_pins_pwr_low", "fpc_mode_as_cs", "fpc_mode_as_ck", "fpc_mode_as_mi", "fpc_mode_as_mo", "fpc_miso_pull_up", "fpc_miso_pull_down", "fpc_mosi_pull_up", "fpc_mosi_pull_down";
			status = "okay";
		};
	};

	fragment@40 {
		target = <0xffffffff>;

		__overlay__ {
			interrupt-parent = <0xffffffff>;
			interrupts = <0x14 0x2 0x14 0x0>;
			status = "okay";
		};
	};

	fragment@41 {
		target = <0xffffffff>;

		__overlay__ {
			interrupt-parent = <0xffffffff>;
			interrupts = <0x27 0x8 0x27 0x0>;
			status = "okay";
		};
	};

	fragment@42 {
		target = <0xffffffff>;

		__overlay__ {
			interrupt-parent = <0xffffffff>;
			interrupts = <0x29 0x2 0x29 0x0>;
			status = "okay";
		};
	};

	fragment@43 {
		target = <0xffffffff>;

		__overlay__ {
			interrupt-parent = <0xffffffff>;
			interrupts = <0x2a 0x2 0x2a 0x0>;
			status = "okay";
		};
	};

	fragment@44 {
		target = <0xffffffff>;

		__overlay__ {
			interrupt-parent = <0xffffffff>;
			interrupts = <0x2c 0x1 0x2c 0x1>;
			status = "okay";
		};
	};

	fragment@45 {
		target = <0xffffffff>;

		__overlay__ {
			interrupt-parent = <0xffffffff>;
			interrupts = <0x90 0x4 0xb4 0x0>;
			status = "okay";
		};
	};

	fragment@46 {
		target = <0xffffffff>;

		__overlay__ {
			compatible = "mediatek,md1_sim1_hot_plug_eint-eint";
			debounce = <0x0 0x2710>;
			dedicated = <0x0 0x0>;
			interrupts = <0x0 0x4>;
			sockettype = <0x0 0x0>;
			src_pin = <0x0 0x1>;
			status = "okay";
		};
	};

	fragment@47 {
		target = <0xffffffff>;

		__overlay__ {
			compatible = "mediatek,md1_sim2_hot_plug_eint-eint";
			debounce = <0x1 0x2710>;
			dedicated = <0x1 0x0>;
			interrupts = <0x1 0x4>;
			sockettype = <0x1 0x0>;
			src_pin = <0x1 0x2>;
			status = "okay";
		};
	};

	fragment@48 {
		target = <0xffffffff>;

		__overlay__ {
			regulator-default-on = <0x1>;
			regulator-name = "vcama1";
			status = "okay";
		};
	};

	fragment@49 {
		target = <0xffffffff>;

		__overlay__ {
			regulator-default-on = <0x1>;
			regulator-name = "vcama2";
			status = "okay";
		};
	};

	fragment@5 {
		target = <0xffffffff>;

		__overlay__ {

			fpcck {
				phandle = <0x8>;

				pins_cmd_dat {
					bias-pull-up = <0x0>;
					pinmux = <0x1b02>;
				};
			};

			fpccs {
				phandle = <0x7>;

				pins_cmd_dat {
					bias-pull-up = <0x0>;
					pinmux = <0x1902>;
				};
			};

			fpcdefault {
				phandle = <0x1>;
			};

			fpceint@0 {
				phandle = <0x2>;

				pins_cmd_dat {
					bias-disable;
					pinmux = <0x500>;
					slew-rate = <0x0>;
				};
			};

			fpcmi {
				phandle = <0x9>;

				pins_cmd_dat {
					bias-pull-up = <0x0>;
					pinmux = <0x1c02>;
				};
			};

			fpcmisolow {
				phandle = <0xc>;

				pins_cmd_dat {
					output-low;
					pinmux = <0x1c00>;
					slew-rate = <0x1>;
				};
			};

			fpcmisoup {
				phandle = <0xb>;

				pins_cmd_dat {
					output-high;
					pinmux = <0x1c00>;
					slew-rate = <0x1>;
				};
			};

			fpcmo {
				phandle = <0xa>;

				pins_cmd_dat {
					bias-pull-down = <0x0>;
					pinmux = <0x1a02>;
				};
			};

			fpcmosilow {
				phandle = <0xe>;

				pins_cmd_dat {
					output-low;
					pinmux = <0x1a00>;
					slew-rate = <0x1>;
				};
			};

			fpcmosiup {
				phandle = <0xd>;

				pins_cmd_dat {
					output-high;
					pinmux = <0x1a00>;
					slew-rate = <0x1>;
				};
			};

			fpcpwrhigh {
				phandle = <0x5>;

				pins_cmd_dat {
					output-high;
					pinmux = <0x400>;
					slew-rate = <0x1>;
				};
			};

			fpcpwrlow {
				phandle = <0x6>;

				pins_cmd_dat {
					output-low;
					pinmux = <0x400>;
					slew-rate = <0x1>;
				};
			};

			fpcrsthigh {
				phandle = <0x3>;

				pins_cmd_dat {
					output-high;
					pinmux = <0xb200>;
					slew-rate = <0x1>;
				};
			};

			fpcrstlow {
				phandle = <0x4>;

				pins_cmd_dat {
					output-low;
					pinmux = <0xb200>;
					slew-rate = <0x1>;
				};
			};
		};
	};

	fragment@50 {
		target = <0xffffffff>;

		__overlay__ {
			regulator-default-on = <0x1>;
			regulator-name = "vsim1";
			status = "okay";
		};
	};

	fragment@51 {
		target = <0xffffffff>;

		__overlay__ {
			regulator-default-on = <0x1>;
			regulator-name = "vsim2";
			status = "okay";
		};
	};

	fragment@52 {
		target = <0xffffffff>;

		__overlay__ {
			regulator-default-on = <0x1>;
			regulator-name = "vcamd";
			status = "okay";
		};
	};

	fragment@53 {
		target = <0xffffffff>;

		__overlay__ {
			regulator-default-on = <0x1>;
			regulator-name = "vcamio";
			status = "okay";
		};
	};

	fragment@54 {
		target = <0xffffffff>;

		__overlay__ {
			regulator-default-on = <0x1>;
			regulator-name = "vldo28";
			status = "okay";
		};
	};

	fragment@55 {
		target = <0xffffffff>;

		__overlay__ {
			status = "okay";
			vcama-supply = <0xffffffff>;
			vcama_sub-supply = <0xffffffff>;
			vcamaf-supply = <0xffffffff>;
			vcamaf_main2-supply = <0xffffffff>;
			vcamaf_sub-supply = <0xffffffff>;
			vcamd_main2-supply = <0xffffffff>;
			vcamio-supply = <0xffffffff>;
			vcamio_main2-supply = <0xffffffff>;
			vcamio_sub-supply = <0xffffffff>;
		};
	};

	fragment@56 {
		target = <0xffffffff>;

		__overlay__ {
			status = "okay";
			vtouch-supply = <0xffffffff>;
		};
	};

	fragment@57 {
		target = <0xffffffff>;

		__overlay__ {
			mediatek,kpd-hw-dl-key0 = <0x11>;
			mediatek,kpd-hw-dl-key1 = <0x0>;
			mediatek,kpd-hw-dl-key2 = <0x8>;
			mediatek,kpd-hw-factory-key = <0x0>;
			mediatek,kpd-hw-init-map = <0x72 0x0 0x0 0x0 0x0 0x0 0x0 0x0 0x0 0x0 0x0 0x0 0x0 0x0 0x0 0x0 0x0 0x0 0x0 0x0 0x0 0x0 0x0 0x0 0x0 0x0 0x0 0x0 0x0 0x0 0x0 0x0 0x0 0x0 0x0 0x0 0x0 0x0 0x0 0x0 0x0 0x0 0x0 0x0 0x0 0x0 0x0 0x0 0x0 0x0 0x0 0x0 0x0 0x0 0x0 0x0 0x0 0x0 0x0 0x0 0x0 0x0 0x0 0x0 0x0 0x0 0x0 0x0 0x0 0x0 0x0 0x0>;
			mediatek,kpd-hw-map-num = <0x48>;
			mediatek,kpd-hw-pwrkey = <0x8>;
			mediatek,kpd-hw-recovery-key = <0x11>;
			mediatek,kpd-hw-rstkey = <0x11>;
			mediatek,kpd-key-debounce = <0x400>;
			mediatek,kpd-pwkey-gpio-din = <0x0>;
			mediatek,kpd-pwrkey-eint-gpio = <0x0>;
			mediatek,kpd-sw-pwrkey = <0x74>;
			mediatek,kpd-sw-rstkey = <0x73>;
			mediatek,kpd-use-extend-type = <0x0>;
			status = "okay";
		};
	};

	fragment@58 {
		target = <0xffffffff>;

		__overlay__ {

			camdefault {
				phandle = <0x26>;
			};

			camera0_mclk_2mA@gpio99 {
				phandle = <0x3a>;

				pins_cmd_dat {
					drive-strength = <0x2>;
					pinmux = <0x6301>;
				};
			};

			camera0_mclk_4mA@gpio99 {
				phandle = <0x3b>;

				pins_cmd_dat {
					drive-strength = <0x4>;
					pinmux = <0x6301>;
				};
			};

			camera0_mclk_6mA@gpio99 {
				phandle = <0x3c>;

				pins_cmd_dat {
					drive-strength = <0x6>;
					pinmux = <0x6301>;
				};
			};

			camera0_mclk_8mA@gpio99 {
				phandle = <0x3d>;

				pins_cmd_dat {
					drive-strength = <0x7>;
					pinmux = <0x6301>;
				};
			};

			camera0_mclk_gpio_mode@gpio99 {
				phandle = <0x39>;

				pins_cmd_dat {
					drive-strength = <0x4>;
					pinmux = <0x6300>;
				};
			};

			camera0_pdn_output_high@gpio107 {
				phandle = <0x2a>;

				pins_cmd_dat {
					output-high;
					pinmux = <0x6b00>;
				};
			};

			camera0_pdn_output_low@gpio107 {
				phandle = <0x29>;

				pins_cmd_dat {
					output-low;
					pinmux = <0x6b00>;
				};
			};

			camera0_rst_output_high@gpio109 {
				phandle = <0x28>;

				pins_cmd_dat {
					output-high;
					pinmux = <0x6d00>;
				};
			};

			camera0_rst_output_low@gpio109 {
				phandle = <0x27>;

				pins_cmd_dat {
					output-low;
					pinmux = <0x6d00>;
				};
			};

			camera0_vcama_output_high@gpio79 {
				phandle = <0x33>;

				pins_cmd_dat {
					output-high;
					pinmux = <0x4f00>;
				};
			};

			camera0_vcama_output_low@gpio178 {
				phandle = <0x34>;

				pins_cmd_dat {
					output-low;
					pinmux = <0x4f00>;
				};
			};

			camera0_vcamd_output_high@gpio80 {
				phandle = <0x35>;

				pins_cmd_dat {
					output-high;
					pinmux = <0x5000>;
				};
			};

			camera0_vcamd_output_low@gpio80 {
				phandle = <0x36>;

				pins_cmd_dat {
					output-low;
					pinmux = <0x5000>;
				};
			};

			camera1_mclk_2mA@gpio100 {
				phandle = <0x3f>;

				pins_cmd_dat {
					drive-strength = <0x2>;
					pinmux = <0x6401>;
				};
			};

			camera1_mclk_4mA@gpio100 {
				phandle = <0x40>;

				pins_cmd_dat {
					drive-strength = <0x4>;
					pinmux = <0x6401>;
				};
			};

			camera1_mclk_6mA@gpio100 {
				phandle = <0x41>;

				pins_cmd_dat {
					drive-strength = <0x6>;
					pinmux = <0x6401>;
				};
			};

			camera1_mclk_8mA@gpio100 {
				phandle = <0x42>;

				pins_cmd_dat {
					drive-strength = <0x7>;
					pinmux = <0x6401>;
				};
			};

			camera1_mclk_gpio_mode@gpio100 {
				phandle = <0x3e>;

				pins_cmd_dat {
					drive-strength = <0x4>;
					pinmux = <0x6400>;
				};
			};

			camera1_pdn_output_high@gpio98 {
				phandle = <0x2e>;

				pins_cmd_dat {
					output-high;
					pinmux = <0x6200>;
				};
			};

			camera1_pdn_output_low@gpio98 {
				phandle = <0x2d>;

				pins_cmd_dat {
					output-low;
					pinmux = <0x6200>;
					slew-rate = <0x1>;
				};
			};

			camera1_rst_output_high@gpio102 {
				phandle = <0x2c>;

				pins_cmd_dat {
					output-high;
					pinmux = <0x6600>;
				};
			};

			camera1_rst_output_low@gpio102 {
				phandle = <0x2b>;

				pins_cmd_dat {
					output-low;
					pinmux = <0x6600>;
				};
			};

			camera1_vcamd_output_high@gpio31 {
				phandle = <0x37>;

				pins_cmd_dat {
					output-high;
					pinmux = <0x1f00>;
				};
			};

			camera1_vcamd_output_low@gpio31 {
				phandle = <0x38>;

				pins_cmd_dat {
					output-low;
					pinmux = <0x1f00>;
				};
			};

			camera2_mclk_2mA@gpio99 {
				phandle = <0x44>;

				pins_cmd_dat {
					drive-strength = <0x2>;
					pinmux = <0x6301>;
				};
			};

			camera2_mclk_4mA@gpio99 {
				phandle = <0x45>;

				pins_cmd_dat {
					drive-strength = <0x4>;
					pinmux = <0x6301>;
				};
			};

			camera2_mclk_6mA@gpio99 {
				phandle = <0x46>;

				pins_cmd_dat {
					drive-strength = <0x6>;
					pinmux = <0x6301>;
				};
			};

			camera2_mclk_8mA@gpio99 {
				phandle = <0x47>;

				pins_cmd_dat {
					drive-strength = <0x7>;
					pinmux = <0x6301>;
				};
			};

			camera2_mclk_gpio_mode@gpio99 {
				phandle = <0x43>;

				pins_cmd_dat {
					drive-strength = <0x4>;
					pinmux = <0x6300>;
				};
			};

			camera2_pdn_output_high@gpio14 {
				phandle = <0x32>;

				pins_cmd_dat {
					output-high;
					pinmux = <0xe00>;
				};
			};

			camera2_pdn_output_low@gpio14 {
				phandle = <0x31>;

				pins_cmd_dat {
					output-low;
					pinmux = <0xe00>;
				};
			};

			camera2_rst_output_high@gpio16 {
				phandle = <0x30>;

				pins_cmd_dat {
					output-high;
					pinmux = <0x1000>;
				};
			};

			camera2_rst_output_low@gpio16 {
				phandle = <0x2f>;

				pins_cmd_dat {
					output-low;
					pinmux = <0x1000>;
				};
			};

			camera2_vcama_output_low@gpio107 {
				phandle = <0x68>;

				pins_cmd_dat {
					output-low;
					pinmux = <0x9600>;
				};
			};
		};
	};

	fragment@59 {
		target = <0xffffffff>;

		__overlay__ {
			cam0_enable_sensor = "ov64b40_mipi_raw s5kgm1st_mipi_raw ";
			cam0_vcamaf-supply = <0xffffffff>;
			cam0_vcamio-supply = <0xffffffff>;
			cam1_enable_sensor = "ov16a1q_mipi_raw gc08a3sub_mipi_raw";
			cam1_vcama-supply = <0xffffffff>;
			cam1_vcamio-supply = <0xffffffff>;
			cam2_enable_sensor = "s5k4h7yx_mipi_raw bf2253Lmacro_mipi_raw";
			cam2_vcama-supply = <0xffffffff>;
			cam2_vcamd-supply = <0xffffffff>;
			cam2_vcamio-supply = <0xffffffff>;
			pinctrl-0 = <0x26>;
			pinctrl-1 = <0x27>;
			pinctrl-10 = <0x30>;
			pinctrl-11 = <0x31>;
			pinctrl-12 = <0x32>;
			pinctrl-13 = <0x33>;
			pinctrl-14 = <0x34>;
			pinctrl-15 = <0x35>;
			pinctrl-16 = <0x36>;
			pinctrl-17 = <0x37>;
			pinctrl-18 = <0x38>;
			pinctrl-19 = <0x39>;
			pinctrl-2 = <0x28>;
			pinctrl-20 = <0x3a>;
			pinctrl-21 = <0x3b>;
			pinctrl-22 = <0x3c>;
			pinctrl-23 = <0x3d>;
			pinctrl-24 = <0x3e>;
			pinctrl-25 = <0x3f>;
			pinctrl-26 = <0x40>;
			pinctrl-27 = <0x41>;
			pinctrl-28 = <0x42>;
			pinctrl-29 = <0x43>;
			pinctrl-3 = <0x29>;
			pinctrl-30 = <0x44>;
			pinctrl-31 = <0x45>;
			pinctrl-32 = <0x46>;
			pinctrl-33 = <0x47>;
			pinctrl-4 = <0x2a>;
			pinctrl-5 = <0x2b>;
			pinctrl-6 = <0x2c>;
			pinctrl-7 = <0x2d>;
			pinctrl-8 = <0x2e>;
			pinctrl-9 = <0x2f>;
			pinctrl-names = "default", "cam0_rst0", "cam0_rst1", "cam0_pnd0", "cam0_pnd1", "cam1_rst0", "cam1_rst1", "cam1_pnd0", "cam1_pnd1", "cam2_rst0", "cam2_rst1", "cam2_pnd0", "cam2_pnd1", "cam0_vcama_on", "cam0_vcama_off", "cam0_vcamd_on", "cam0_vcamd_off", "cam1_vcamd_on", "cam1_vcamd_off", "cam0_mclk_off", "cam0_mclk_2mA", "cam0_mclk_4mA", "cam0_mclk_6mA", "cam0_mclk_8mA", "cam1_mclk_off", "cam1_mclk_2mA", "cam1_mclk_4mA", "cam1_mclk_6mA", "cam1_mclk_8mA", "cam2_mclk_off", "cam2_mclk_2mA", "cam2_mclk_4mA", "cam2_mclk_6mA", "cam2_mclk_8mA";
			status = "okay";
		};
	};

	fragment@6 {
		target = <0xffffffff>;

		__overlay__ {

			led@0 {
				compatible = "mediatek,red";
				data = <0x1>;
				led_mode = <0x0>;
				phandle = <0x4e>;
				pwm_config = <0x0 0x0 0x0 0x0 0x0>;
			};

			led@1 {
				compatible = "mediatek,green";
				data = <0x1>;
				led_mode = <0x0>;
				phandle = <0x4f>;
				pwm_config = <0x0 0x0 0x0 0x0 0x0>;
			};

			led@2 {
				compatible = "mediatek,blue";
				data = <0x1>;
				led_mode = <0x0>;
				phandle = <0x50>;
				pwm_config = <0x0 0x0 0x0 0x0 0x0>;
			};

			led@3 {
				compatible = "mediatek,jogball-backlight";
				data = <0x1>;
				led_mode = <0x0>;
				phandle = <0x51>;
				pwm_config = <0x0 0x0 0x0 0x0 0x0>;
			};

			led@4 {
				compatible = "mediatek,keyboard-backlight";
				data = <0x1>;
				led_mode = <0x0>;
				phandle = <0x52>;
				pwm_config = <0x0 0x0 0x0 0x0 0x0>;
			};

			led@5 {
				compatible = "mediatek,button-backlight";
				data = <0x1>;
				led_mode = <0x0>;
				phandle = <0x53>;
				pwm_config = <0x0 0x0 0x0 0x0 0x0>;
			};

			led@6 {
				compatible = "mediatek,lcd-backlight";
				data = <0x1>;
				led_mode = <0x5>;
				phandle = <0x54>;
				pwm_config = <0x0 0x3 0x0 0x0 0x0>;
			};

			vibrator@0 {
				compatible = "mediatek,vibrator";
				phandle = <0x55>;
				vib_limit = <0x9>;
				vib_timer = <0x19>;
				vib_vol = <0xb>;
			};
		};
	};

	fragment@60 {
		target = <0xffffffff>;

		__overlay__ {
			camaf_m1_pmic-supply = <0xffffffff>;
			camaf_m2_pmic-supply = <0xffffffff>;
			camaf_m3_pmic-supply = <0xffffffff>;
			status = "okay";
		};
	};

	fragment@61 {
		target = <0xffffffff>;

		__overlay__ {
			clock-frequency = <0x61a80>;

			focaltech@48 {
				compatible = "focaltech,fts";
				interrupt-parent = <0xffffffff>;
				interrupts = <0x1 0x2 0x1 0x0>;
				reg = <0x48>;
				status = "okay";
			};

			tcm_touch@2c {
				compatible = "omnivision,tcm-i2c";
				interrupt-parent = <0xffffffff>;
				interrupts = <0x2 0x1 0x0>;
				omnivision,block-delay-us = <0x0>;
				omnivision,byte-delay-us = <0x0>;
				omnivision,irq-gpio = <0xffffffff 0x1 0x2008>;
				omnivision,irq-on-state = <0x0>;
				omnivision,power-delay-ms = <0xc8>;
				omnivision,reset-active-ms = <0x14>;
				omnivision,reset-delay-ms = <0xc8>;
				omnivision,reset-gpio = <0xffffffff 0x17 0x1>;
				omnivision,reset-on-state = <0x0>;
				omnivision,ubl-byte-delay-us = <0x14>;
				omnivision,ubl-max-freq = <0x2dc6c0>;
				pinctrl-0 = <0x48 0x49>;
				pinctrl-1 = <0x4a 0x4b>;
				pinctrl-names = "pmx_ts_active", "pmx_ts_suspend";
				reg = <0x2c>;
			};
		};
	};

	fragment@62 {
		target = <0xffffffff>;

		__overlay__ {
			goodix,eint-gpio = <0xffffffff 0x1 0x0>;
			goodix,reset-gpio = <0xffffffff 0x17 0x0>;
			gpio_tp_int = <0xffffffff 0x1 0x0>;
			gpio_tp_rst = <0xffffffff 0x17 0x0>;
			interrupt-parent = <0xffffffff>;
			interrupts = <0x1 0x2 0x1 0x0>;
			lcm-resolution = <0x438 0x924>;
			status = "okay";
			tpd-cfg-version = "config19";
			tpd-filter-custom-prameters = <0x0 0x0 0x0 0x0 0x0 0x0 0x0 0x0 0x0 0x0 0x0 0x0>;
			tpd-filter-custom-speed = <0x0 0x0 0x0>;
			tpd-filter-enable = <0x0>;
			tpd-filter-pixel-density = <0xa8>;
			tpd-max-touch-num = <0x5>;
			tpd-resolution = <0x438 0x924>;
			vtouch-supply = <0xffffffff>;
		};
	};

	fragment@63 {
		target = <0xffffffff>;

		__overlay__ {

			eintdefault {
				phandle = <0x69>;
			};

			i2cmode_default {
				phandle = <0x6a>;

				pins_cmd_dat {
					pinmux = <0x5201 0x5301>;
				};
			};

			int_active {
				phandle = <0x48>;

				pins_cmd_dat {
					bias-pill-up = <0x67>;
					input-enable;
					pinmux = <0x100>;
				};
			};

			int_high {
				phandle = <0x6b>;

				pins_cmd_dat {
					output-high;
					pinmux = <0x100>;
					slew-rate = <0x1>;
				};
			};

			int_suspend {
				phandle = <0x4a>;

				pins_cmd_dat {
					output-low;
					pinmux = <0x100>;
					slew-rate = <0x1>;
				};
			};

			reset_active {
				phandle = <0x49>;

				pins_cmd_dat {
					output-high;
					pinmux = <0x1700>;
					slew-rate = <0x1>;
				};
			};

			reset_suspend {
				phandle = <0x4b>;

				pins_cmd_dat {
					output-low;
					pinmux = <0x1700>;
					slew-rate = <0x1>;
				};
			};
		};
	};

	fragment@7 {
		target = <0xffffffff>;

		__overlay__ {
			gpio_lcd_bias_enn_gpio = <0xffffffff 0xa5 0x0>;
			gpio_lcd_bias_enn_pin = <0xa5>;
			gpio_lcd_bias_enp_gpio = <0xffffffff 0xa9 0x0>;
			gpio_lcd_bias_enp_pin = <0xa9>;
			gpio_lcd_ldo18_gpio = <0xffffffff 0x4e 0x0>;
			gpio_lcd_ldo18_pin = <0x4e>;
		};
	};

	fragment@8 {
		target = <0xffffffff>;

		__overlay__ {
			clock-frequency = <0x61a80>;

			mtk-usb@60 {
				compatible = "mediatek,mtk-usb";
				reg = <0x60>;
				status = "okay";
			};
		};
	};

	fragment@9 {
		target = <0xffffffff>;

		__overlay__ {

			irq_nfc {
				compatible = "mediatek,irq_nfc-eint";
				debounce = <0x0>;
				interrupt-parent = <0xffffffff>;
				interrupts = <0x9 0x1 0x9 0x0>;
				phandle = <0x57>;
				status = "okay";
			};

			nfc {
				compatible = "mediatek,nfc-gpio-v2";
				gpio-irq = <0x9>;
				gpio-irq-std = <0xffffffff 0x9 0x0>;
				gpio-rst = <0x9f>;
				gpio-rst-std = <0xffffffff 0x9f 0x0>;
				phandle = <0x56>;
			};
		};
	};
};
